/*
 * XMSS / XMSS^MT known-answer tests (XMSS reference implementation)
 *
 * There are no NIST ACVP vectors for XMSS; the vectors in xmss_vectors.h
 * are generated by scripts/gen_test_vectors.sh with the XMSS reference
 * implementation (RFC 8391 authors, with the SP 800-208 parameter sets):
 *   - XMSS (SHA2_10_256, SHA2_10_192, SHAKE256_10_256, SHAKE256_10_192):
 *     3 signatures each, verified; the randomizer r and the WOTS+
 *     signature are regenerated from the seeds and compared byte by byte
 *     (the host tests also regenerate the public key and the whole
 *     signature)
 *   - XMSS^MT (all 24 SP 800-208 sets with trees of height <= 10):
 *     one signature each, verified
 * Every signature is also checked with a flipped bit, a changed message
 * and a truncated signature, which must be rejected.
 *
 * Then stateful round trips: XMSS^MT keys with trees of height 5
 * (XMSSMT-*_20/4_*) are generated, 40 messages signed (crossing into a new
 * bottom tree) and verified.
 *
 * Copyright (c) 2026 The sp800-208-xmss-esp32 authors
 * SPDX-License-Identifier: Apache-2.0
 */

#include <Arduino.h>
#include <XMSS.h>

#define KAT_PRINTF(...) Serial.printf(__VA_ARGS__)
#include "kat_runner.h"

static const uint32_t TRIPS[] = {XMSSMT_SHA2_20_4_256, XMSSMT_SHA2_20_4_192,
                                 XMSSMT_SHAKE256_20_4_192};
static uint8_t sig[12 * 1024];

static void roundTrip(kat_result *r, uint32_t oid) {
  XMSSRamStorage storage;  // volatile: fine for a test
  XMSSMTKey key;
  const char *name = xmssmt_param_get(oid)->name;
  uint8_t pk[68], msg[33];
  size_t pkLen = sizeof pk;
  unsigned long t0 = millis();
  int rc = key.generate(storage, oid);
  kat_check(r, rc == XMSS_OK, "key generation failed", name);
  if (rc != XMSS_OK) return;
  key.publicKey(pk, &pkLen);
  for (unsigned i = 0; i < 40; i++) {
    size_t sigLen = sizeof sig;
    esp_fill_random(msg, sizeof msg);
    rc = key.sign(msg, sizeof msg, sig, &sigLen);
    if (rc != XMSS_OK || XMSSMTKey::verify(pk, pkLen, msg, sizeof msg, sig, sigLen) != 0) {
      kat_check(r, 0, "sign / verify failed", name);
      return;
    }
    if (i == 39) {
      sig[sigLen / 2] ^= 0x01;
      kat_check(r, XMSSMTKey::verify(pk, pkLen, msg, sizeof msg, sig, sigLen) != 0,
                "tampered signature accepted", name);
    }
  }
  kat_check(r, key.nextIndex() == 40, "wrong counter", name);
  KAT_PRINTF("round trip %-26s 40 signatures ok (%lu ms)\n", name, millis() - t0);
}

static void testTask(void *) {
  Serial.println();
  Serial.println("================================================");
  Serial.println("  XMSS / XMSS^MT Known-Answer Tests");
  Serial.println("  (XMSS reference implementation vectors)");
  Serial.println("================================================");
  Serial.printf("SHA-256: %s\n", xmss_hw_sha_active() ? "hardware" : "software");
  kat_result r;
  unsigned long t0 = millis();
  kat_run_all(&r);
  KAT_PRINTF("--- stateful round trips (XMSS^MT, 4 layers of height 5) ---\n");
  for (uint32_t oid : TRIPS) {
    roundTrip(&r, oid);
  }
  Serial.println();
  Serial.println("================================================");
  Serial.printf("  Results: %u passed, %u failed (%lu s)\n", r.pass, r.fail, (millis() - t0) / 1000);
  Serial.println(r.fail == 0 ? "  ALL TESTS PASSED" : "  SOME TESTS FAILED");
  Serial.println("================================================");
  vTaskDelete(NULL);
}

void setup() {
  Serial.begin(115200);
  delay(1000);
  xTaskCreatePinnedToCore(testTask, "kat", 16 * 1024, NULL, 1, NULL, 1);
}

void loop() {
  delay(1000);
}
